## components/async_logging/Kconfig
```kconfig
menu "Async Logging"
    config ASYNC_LOGGING_BUFFER_LEN
        int "Async logging buffer length"
        default 4096
    config ASYNC_LOGGING_ENABLED
        bool "Async logging is enabled"
        default y
endmenu
```

## components/libcrsf/Kconfig
```kconfig
menu "libcrsf"
    config LIBCRSF_PARAM_MAX_COUNT
        int "Maximum number of parameters"
        default 20
    config LIBCRSF_PARAM_SELECT_OPTION_MAX_COUNT
        int "Maximum number of options in SELECT parameter entries"
        default 10
endmenu
```

## components/mim_conn/Kconfig
```kconfig
menu "libnet"
    # Ethernet hardware pins
    config LIBNET_W5500_SPI_MISO
        int "W5500 SPI MISO pin"
        default 12
    config LIBNET_W5500_SPI_MOSI
        int "W5500 SPI MOSI pin"
        default 11
    config LIBNET_W5500_SPI_SCLK
        int "W5500 SPI SCLK pin"
        default 13
    config LIBNET_W5500_SPI_CS
        int "W5500 SPI CS pin"
        default 14
    config LIBNET_W5500_SPI_RST
        int "W5500 SPI RST pin"
        default 9
    config LIBNET_W5500_SPI_INT
        int "W5500 SPI INT pin"
        default 10
endmenu
```

## main/Kconfig.projbuild
```kconfig
menu "CRSF-MIM"
    config MIM_PIN_CONTROLLER
        int "Controller GPIO pin"
        default 45
        help
            "GPIO pin number connected to the Controller"
    config MIM_PIN_MODULE
        int "Module GPIO pin"
        default 46
        help
            "GPIO pin number connected to the TX Module"
    config MIM_SKYMAP_UDP_PORT
        int "UDP port for Skymap"
        help
            "UDP Port on which Skymap will send TATEP traffic"
    config MIM_WIFI_SSID
        string "WiFi SSID"
        help
            WiFi SSID for Wifi Mode
    config MIM_WIFI_PASSWORD
        string "WiFi Password"
        help
            WiFi Password for WiFi Mode
    config MIM_CHANNELS_RESPONSE
        bool "Respond with Channels Message"
        default n
        help
            "Will respond with overridden first 4 channels for debugging"

    config MIM_PANEL_ENABLED
        bool "Enable HTTP dashboard"
        select HTTPD_WS_SUPPORT
        default y
        help
          "HTTP dashboard that displays interceptor and target, config, and engagement controls"
    config MIM_PANEL_MAX_CLIENTS
        int "Max number of clients for the HTTP dashboard"
        default 5
        help
            "Multiple clients can view and interact with the HTTP panel"
    config MIM_PANEL_RATE_HZ
        int "HTTP dashboard refresh rate"
        default 4
endmenu
```

## sdkconfig.defaults
```kconfig
CONFIG_ETH_SPI_ETHERNET_W5500=y
CONFIG_FREERTOS_HZ=500

CONFIG_CRSF_MIM_WIFI_SSID="16pro"
CONFIG_CRSF_MIM_WIFI_PASSWORD="1234567890"
CONFIG_CRSF_MIM_SKYMAP_UDP_PORT=8888

CONFIG_HTTPD_MAX_URI_LEN=64

CONFIG_ESPTOOLPY_FLASHSIZE_8MB=y
CONFIG_PARTITION_TABLE_CUSTOM=y
CONFIG_PARTITION_TABLE_FILENAME="partitions.csv"
```

## test_app/main/Kconfig
```kconfig
menu "CRSF-MIM-TEST"
    config CRSF_MIM_TEST_WIFI_SSID
        string "WiFi SSID"
        default "m1"
        help
            WiFi SSID for Wifi Mode
    config CRSF_MIM_TEST_WIFI_PASSWORD
        string "WiFi Password"
        default "01234567890"
        help
            WiFi Password for WiFi Mode
    config CRSF_MIM_TEST_NETIF_REPEATS
        int "Netif test repeats"
        default 0
        help "Number of time to init and deinit network interfaces"
endmenu
```
